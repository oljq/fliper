#include "ekran.h"
#include "ir.h"  

Adafruit_SSD1306 display(SCREEN_WIDTH, SCREEN_HEIGHT, &Wire, -1);
bool Ekran::firstScreen = true;

const byte PROGMEM frames[][288] = {
  {0,0,0,0,0,0,0,0,0,0,0,0,0,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0,0},
  {0,0,0,0,0,0,0,0,0,0,0,0,0,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0,0},
  {0,0,0,0,0,0,0,0,0,0,0,0,0,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0,0},
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  {0,0,0,0,0,0,0,0,0,0,0,0,0,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0,0}
};

Ekran::Ekran() /* :ir(IR_RECV_PIN, IR_SEND_PIN)*/{
    ListMainMenu.push_back("Ir receiver");
    ListMainMenu.push_back("Ir emission");
    ListMainMenu.push_back("Wifi scane");
    ListMainMenu.push_back("BLE");
    ListMainMenu.push_back("Game");
    ListMainMenu.push_back("Back to home screen");
}

void Ekran::begin() {
    Wire.begin(21, 22);//sck-22, sda 21

    if (!display.begin(SSD1306_SWITCHCAPVCC, OLED_ADDR)) {       
        while (true);
    }
    //ir.begin();
    eWiFi.begin();
    eWiFi.scanNetwork();

    eBle.begin();
    eBle.scan(3);
    

    display.clearDisplay();
    display.display();
}

void Ekran::pocetni(){
  display.clearDisplay();
  display.drawBitmap(40, 8, frames[frame], FRAME_WIDTH, FRAME_HEIGHT, 1);
  display.display();
  frame = (frame + 1) % FRAME_COUNT;
  delay(FRAME_DELAY);
}

void Ekran::brisi(){
    display.clearDisplay();
    display.display();
}

void Ekran::DrawMeni(ScreenState currentScreen, int s, bool save, int index,bool send, bool moveRight, bool moveLeft){

    switch(currentScreen){
        case SCREEN_MAIN_MENU:
            MainMeni(s);
            break;

        case SCREEN_IR_RECEIVER:
            IrReciver(save);
            break;

        case SCREEN_IR_EMISSION:
            IrEmission(index,send);
            break;

        case SCREEN_WIFI:
            Network();
            break;

        case SCREEN_BLE:
            BleScan();
            break;

        case SCREEN_GAME:
            Game(moveRight, moveLeft);
            break;
    }

    

}

void Ekran::MainMeni(int s){

    display.clearDisplay();
    display.setTextSize(2);
    display.setTextColor(SSD1306_WHITE,SSD1306_BLACK);
    
    int y=0;
    display.setCursor(0, y);
    display.println("Main menu");
    display.println(" ");
    y+=20;

    if(s<4){
        for(int i=0; i<ListMainMenu.size(); i++){       
            if(i==s){
                display.setTextColor(SSD1306_BLACK, SSD1306_WHITE);
            }else{
                display.setTextColor(SSD1306_WHITE,SSD1306_BLACK);          
            } 
            display.setTextSize(1);
            display.setCursor(5,y);
            display.println(ListMainMenu[i]);
            y+=10;

        }
    }else{
        for(int i=3; i<ListMainMenu.size(); i++){       
            if(i==s){
                display.setTextColor(SSD1306_BLACK, SSD1306_WHITE);
            }else{
                display.setTextColor(SSD1306_WHITE,SSD1306_BLACK);          
            } 
            display.setTextSize(1);
            display.setCursor(5,y);
            display.println(ListMainMenu[i]);
            y+=10;

        }
    }  
    display.display();

}

void Ekran::IrReciver(bool save){
    /*
    display.clearDisplay();
    display.setTextSize(2);
    display.setTextColor(SSD1306_WHITE,SSD1306_BLACK);
    display.setCursor(0, 0);
    display.println("Ir reciver");
    display.println(" ");
    
    long irRead = ir.read();
    
    display.setTextSize(1);
    display.setCursor(0, 25); 
    display.println("Code:");
    display.setCursor(50, 25);

    if(irRead!= -1){
        lastIrRead=irRead;    
        display.println(lastIrRead);

    }else{
        display.println(lastIrRead);
    }

    display.setCursor(0, 40); 
    display.println("Save with btn1");

    if(save){
        ir.save(lastIrRead);
        display.setCursor(0, 50); 
        display.print("Save:");
        display.println(lastIrRead);
        delay(200);
    }

    display.display();
    delay(200);
    */
}

void Ekran::IrEmission(int index ,bool  send){
    /*
    File file = LittleFS.open("/ir_codes.txt", FILE_READ);

    display.clearDisplay();
    display.setTextSize(2);
    display.setTextColor(SSD1306_WHITE,SSD1306_BLACK);
    display.setCursor(0, 0);
    display.print("Ir send");
    display.setCursor(100, 0);
    display.println(ir.numberOfLines);
    display.println(" ");

    display.setTextSize(1);
    display.setTextColor(SSD1306_WHITE,SSD1306_BLACK);
    int y=20;

    if (!file) {
        display.setCursor(0, y);
        display.println("No file");      
        display.display();
        return;
    }    
    
    bool empty = true;
    int brojac=1;
    String selectedLine;
    
    if(ir.numberOfLines>0){
        index %= ir.numberOfLines; 
    }
    

    while (file.available()) {
        empty = false;
        String line = file.readStringUntil('\n'); 

        display.setCursor(0, y);
        if(brojac==index){
            display.setTextColor(SSD1306_BLACK, SSD1306_WHITE);
            selectedLine=line;
        }
        else display.setTextColor(SSD1306_WHITE,SSD1306_BLACK);
        display.println(line);
        y += 10;
        brojac++;
    }

    if (empty) {
        display.setCursor(0, y);
        display.println("Empty file");
    }


    if(send && selectedLine.length()>0){
        unsigned long value = selectedLine.toInt();
        ir.send(value);
    }

    file.close();
    display.display();
    */
    
}


void Ekran::Network(){
    std::vector<String> ispis = eWiFi.ispis;
    display.clearDisplay();
    display.setTextSize(2);
    display.setTextColor(SSD1306_WHITE,SSD1306_BLACK);
    display.setCursor(0, 0);
    display.println("WiFi scan");
    int y=20;
    display.setTextSize(1);
    display.setCursor(0,y);

    if(ispis.size() == 0){
        display.setCursor(0, y);
        display.println("Nema");
    }
    else{
        for(int i = 0; i < ispis.size(); i++){
            display.setCursor(0, y);
            display.println(ispis[i]);
            y += 10;
        }
    }

    display.display();
}


void Ekran::BleScan(){
    std::vector<String> ispis = eBle.ispis;
    display.clearDisplay();
    display.setTextSize(2);
    display.setTextColor(SSD1306_WHITE,SSD1306_BLACK);
    display.setCursor(0, 0);
    display.println("Ble scan");
    int y=20;
    display.setTextSize(1);
    display.setCursor(0,y);

    if(ispis.size() == 0){
        display.setCursor(0, y);
        display.println("Nema");
    }
    else{
        for(int i = 0; i < ispis.size(); i++){
            display.setCursor(0, y);
            display.println(ispis[i]);
            y += 10;
        }
    }


    display.display();
    
}



void Ekran::Game(bool moveRight, bool moveLeft){
    display.clearDisplay();
    display.setTextSize(1);
    display.setTextColor(SSD1306_WHITE,SSD1306_BLACK);
    display.setCursor(0, 0);
    display.print("Score:");
    display.setCursor(100,0);
    display.println(score,0);
    display.drawLine(0, 10, 127, 10, SSD1306_WHITE);
    score+=0.1;


    if(moveRight) playerX+=2;
    if(moveLeft) playerX-=2;

    if (playerX < 0) playerX = 0;
    if (playerX > 118) playerX = 118;

    display.drawRect(playerX,playerY,10,10, SSD1306_WHITE);

    if(score > 50) obstacleY += 3;
    else if(score > 20) obstacleY += 2;
    else obstacleY += 1;


    if(obstacleY>64){
        obstacleY=12;
        obstacleX= random(0,118);
    }

    display.drawChar(obstacleX, obstacleY, '*', SSD1306_WHITE, SSD1306_BLACK, 1);

    if(checkCollision(playerX, playerY, 10,10,obstacleX, obstacleY,5,7)){
        display.clearDisplay();
        display.setTextSize(2);
        display.setTextColor(SSD1306_WHITE,SSD1306_BLACK);
        display.setCursor(10, 30);
        display.print("Game over");
        display.display(); 
        delay(3000);
        currentScreen= SCREEN_MAIN_MENU;
        obstacleY=12;
        obstacleX=30;
        score=0;
        return;
    }
    
    display.display();

}

bool Ekran::checkCollision(int px, int py, int pw, int ph, int ox, int oy, int ow, int oh){
    return !(px + pw < ox ||     // player levo od prepreke
             px > ox + ow ||     // player desno od prepreke
             py + ph < oy ||     // player iznad prepreke
             py > oy + oh); 

}


